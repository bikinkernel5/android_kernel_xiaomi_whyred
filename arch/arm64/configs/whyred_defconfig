## arch/arm64/configs/whyred_defconfig
```kconfig
CONFIG_LOCALVERSION="-whyred-droidian"
# CONFIG_LOCALVERSION_AUTO is not set
CONFIG_HIGH_RES_TIMERS=y
CONFIG_IKCONFIG=y
CONFIG_IKCONFIG_PROC=y
CONFIG_LOG_BUF_SHIFT=14
CONFIG_CGROUPS=y
CONFIG_CGROUP_FREEZER=y
CONFIG_CPUSETS=y
CONFIG_MEMCG=y
CONFIG_USER_NS=y
CONFIG_ARCH_QCOM=y
CONFIG_NR_CPUS=8
CONFIG_PREEMPT=y
CONFIG_SECCOMP=y
CONFIG_NET=y
CONFIG_PACKET=y
CONFIG_UNIX=y
CONFIG_INET=y
CONFIG_NETFILTER=y
CONFIG_BRIDGE=y
CONFIG_DEVTMPFS=y
CONFIG_DEVTMPFS_MOUNT=y
CONFIG_INPUT_EVDEV=y
CONFIG_DEVPTS_MULTIPLE_INSTANCES=y
CONFIG_SERIAL_MSM=y
CONFIG_SERIAL_MSM_CONSOLE=y
CONFIG_I2C_QUP=y
CONFIG_SPI=y
CONFIG_SPI_QUP=y
CONFIG_DRM=y
CONFIG_DRM_PANEL_SIMPLE=y
CONFIG_STAGING=y
CONFIG_ASHMEM=y
CONFIG_ION=y
CONFIG_ANDROID=y
CONFIG_ANDROID_BINDER_IPC=y
CONFIG_EXT4_FS=y
CONFIG_FANOTIFY=y
CONFIG_AUTOFS4_FS=y
CONFIG_FUSE_FS=y
CONFIG_CUSE=y
CONFIG_OVERLAY_FS=y
CONFIG_VFAT_FS=y
CONFIG_TMPFS_POSIX_ACL=y
CONFIG_DEBUG_FS=y
CONFIG_MAGIC_SYSRQ=y
CONFIG_KEYS=y
CONFIG_SECURITY=y
CONFIG_WERROR=n
```

## defconfig
```kconfig
CONFIG_LOCALVERSION="-whyred-droidian"
CONFIG_LOCALVERSION_AUTO=n
CONFIG_ARCH_QCOM=y
CONFIG_ARM64=y
CONFIG_SMP=y
CONFIG_NR_CPUS=8
CONFIG_PREEMPT=y
CONFIG_HIGH_RES_TIMERS=y

# DRM/KMS (GUI/Linux native display)
CONFIG_DRM=y
CONFIG_DRM_MSM=y
CONFIG_DRM_MSM_DSI=y
CONFIG_DRM_KMS_HELPER=y
CONFIG_DRM_PANEL_SIMPLE=y
CONFIG_BACKLIGHT_CLASS_DEVICE=y
CONFIG_BACKLIGHT_GENERIC=y

# Halium Binder & Android Subsystems
CONFIG_ANDROID=y
CONFIG_ANDROID_BINDER_IPC=y
CONFIG_ANDROID_BINDER_DEVICES="binder,hwbinder,vndbinder"
CONFIG_ASHMEM=y
CONFIG_ION=y
CONFIG_STAGING=y

# Required for Halium init/udev
CONFIG_DEVTMPFS=y
CONFIG_DEVTMPFS_MOUNT=y
CONFIG_PROC_FS=y
CONFIG_TMPFS=y
CONFIG_TMPFS_POSIX_ACL=y
CONFIG_SYSFS=y
CONFIG_DEVPTS_MULTIPLE_INSTANCES=y

# Namespace + Container support (Droidian)
CONFIG_NAMESPACES=y
CONFIG_UTS_NS=y
CONFIG_IPC_NS=y
CONFIG_USER_NS=y
CONFIG_PID_NS=y
CONFIG_NET_NS=y
CONFIG_CGROUPS=y
CONFIG_CGROUP_FREEZER=y
CONFIG_CPUSETS=y
CONFIG_MEMCG=y
CONFIG_OVERLAY_FS=y
CONFIG_FUSE_FS=y
CONFIG_CUSE=y
CONFIG_SECCOMP=y
CONFIG_SECCOMP_FILTER=y

# Network support for container & systemd
CONFIG_NET=y
CONFIG_PACKET=y
CONFIG_UNIX=y
CONFIG_INET=y
CONFIG_TUN=y
CONFIG_VETH=y
CONFIG_BRIDGE=y
CONFIG_NETFILTER=y

# Filesystems
CONFIG_EXT4_FS=y
CONFIG_VFAT_FS=y
CONFIG_FANOTIFY=y
CONFIG_AUTOFS4_FS=y

# Basic drivers
CONFIG_INPUT_EVDEV=y
CONFIG_I2C=y
CONFIG_I2C_QUP=y
CONFIG_SPI=y
CONFIG_SPI_QUP=y

# USB basic
CONFIG_USB_SUPPORT=y
CONFIG_USB_COMMON=y
CONFIG_USB_EHCI_HCD=y
CONFIG_USB_OHCI_HCD=y
CONFIG_USB_STORAGE=y

# Virtio (optional)
CONFIG_VIRTIO=y
CONFIG_VIRTIO_CONSOLE=y
CONFIG_VIRTIO_BLK=y
CONFIG_VIRTIO_NET=y

# Serial console
CONFIG_SERIAL_MSM=y
CONFIG_SERIAL_MSM_CONSOLE=y

# Security
CONFIG_SECURITY=y
CONFIG_SECURITY_SELINUX_BOOTPARAM=y
CONFIG_SECURITY_SELINUX_BOOTPARAM_VALUE=1
CONFIG_SECURITY_SELINUX_DISABLE=y
CONFIG_DEFAULT_SECURITY_APPARMOR=y
CONFIG_KEYS=y

# Debug/dev
CONFIG_LOG_BUF_SHIFT=14
CONFIG_KALLSYMS_ALL=y
CONFIG_DEBUG_FS=y
CONFIG_MAGIC_SYSRQ=y
CONFIG_IKCONFIG=y
CONFIG_IKCONFIG_PROC=y
```
